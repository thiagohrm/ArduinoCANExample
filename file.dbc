VERSION ""

NS_ :

BS_:

BU_:

BO_ 1 TEMP_REQUEST: 8 Vector__XXX
	SG_ TEMP_REQ : 0|1@1+ (0,0) [0|1] "" Vector__XXX

BO_ 2 HUMIDITY_REQUEST: 8 Vector__XXX
	SG_ HUMIDITY_REQ : 0|1@1+ (0,0) [0|1] "" Vector__XXX

BO_ 3 STRING_REQUEST: 8 Vector__XXX
	SG_ STRING_REQ : 0|1@1+ (0,0) [0|1] "" Vector__XXX

BO_ 4 TEMP_RESPONSE: 8 Vector__XXX
	SG_ TEMP_VALUE : 0|7@1+ (0,0) [0|127] "" Vector__XXX

BO_ 5 HUMIDITY_RESPONSE: 8 Vector__XXX
	SG_ HUMIDITY_VALUE : 0|7@1+ (0,0) [0|127] "" Vector__XXX

BO_ 6 STRING_RESPONSE: 0 Vector__XXX
	SG_  : 0|0@1+ (0,0) [0|0] "" Vector__XXX

BA_DEF_ SG_  "SPN" INT 0 524287;
BA_DEF_ BO_  "VFrameFormat" ENUM  "StandardCAN","ExtendedCAN","reserved","J1939PG";
BA_DEF_  "DatabaseVersion" STRING ;
BA_DEF_  "BusType" STRING ;
BA_DEF_  "ProtocolType" STRING ;
BA_DEF_  "DatabaseCompiler" STRING ;
BA_DEF_DEF_  "SPN" 0;
BA_DEF_DEF_  "VFrameFormat" "J1939PG";
BA_DEF_DEF_  "DatabaseVersion" "DEMO PLUS";
BA_DEF_DEF_  "BusType" "";
BA_DEF_DEF_  "ProtocolType" "";
BA_DEF_DEF_  "DatabaseCompiler" "";
BA_ "ProtocolType" "J1939";
BA_ "BusType" "CAN";
BA_ "DatabaseCompiler" "CSS ELECTRONICS (WWW.CSSELECTRONICS.COM)";
BA_ "DatabaseVersion" "1.0.0";
BA_ "SPN" SG_ 2364540158 EngineSpeed 190;
BA_ "SPN" SG_ 2566844926 WheelBasedVehicleSpeed 84;
